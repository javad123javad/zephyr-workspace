/*
 * Copyright 2024 NXP
 *
 * SPDX-License-Identifier: Apache-2.0
 */

/ {
	aliases {
		gnss = &gnss;
	};
};
&usart2 {
	pinctrl-0 = <&usart2_tx_pa2 &usart2_rx_pa3>;
	pinctrl-names = "default";
	status = "okay";
	current-speed = <9600>;
	gnss: u_blox_6m {
		status = "okay";
		compatible = "gnss-nmea-generic";
		//initial-baudrate = <9600>;
	};
};
