## gnss/boards/blackpill_f411ce.conf
```kconfig
# Copyright 2024 NXP
# SPDX-License-Identifier: Apache-2.0

CONFIG_UART_INTERRUPT_DRIVEN=y
# CONFIG_GNSS_U_BLOX_6M=y
```

## llcc68/drivers/dts/bindings/llcc68/semtech,llcc68.yml
```yaml
# Copyright (c) 2019 Manivannan Sadhasivam
# Copyright (c) 2020 Andreas Sandberg
# SPDX-License-Identifier: Apache-2.0

include: spi-device.yaml

properties:
  reset-gpios:
    type: phandle-array
    description: |
      GPIO connected to the modem's NRESET signal.

      This signal is open-drain, active-low as interpreted by the
      modem.

  busy-gpios:
    type: phandle-array
    description: |
      GPIO connected to the modem's BUSY signal.

dio1-gpios:
  type: phandle-array
  description: |
    GPIO connected to DIO1. This GPIO will be used as a generic
    IRQ line from the chip.
```

## llcc68/drivers/llcc68/Kconfig
```kconfig
config LLCC68
    bool "LLCC68 LoRa Transceiver Driver"
    default y
    select SPI
    help
      Enable LLCC68 LoRa Transceiver Driver

config LLCC68_LOG_LEVEL
    int "LLCC68 Log Level"
    depends on LLCC68
    default 0
    help
      Set log level for LLCC68 driver
```
