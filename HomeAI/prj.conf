## prj.conf
```kconfig
#
# Copyright (c) 2023 Nordic Semiconductor ASA
#
# SPDX-License-Identifier: Apache-2.0
#
CONFIG_BT=y
CONFIG_BT_PERIPHERAL=y
CONFIG_BT_DEVICE_NAME="LIVROOM"
CONFIG_SENSOR=y
CONFIG_SENSOR_ASYNC_API=y
CONFIG_I2C=y
```

## src/main.c
```c
/*
 * Copyright (c) 2023 Nordic Semiconductor ASA
 *
 * SPDX-License-Identifier: Apache-2.0
 */

#include "zephyr/sys/printk.h"
#include <zephyr/bluetooth/bluetooth.h>
#include <zephyr/bluetooth/uuid.h>

#include "bmp280.h"
//bmp280







////////////////////////
#define SERVICE_DATA_LEN        10		   /* Length of service data */
#define SERVICE_UUID            0xfcd2      /* BTHome service UUID */
#define IDX_TEMPL               4           /* Index of lo byte of temp in service data*/
#define IDX_TEMPH               5           /* Index of hi byte of temp in service data*/
#define IDX_PRESSL              7           /* Index of lo byte of humidity in service data*/
#define IDX_PRESSM              8           /* Index of hi byte of humidity in service data*/
#define IDX_PRESSH 				9


#define ADV_PARAM BT_LE_ADV_PARAM(BT_LE_ADV_OPT_USE_IDENTITY, \
				  BT_GAP_ADV_SLOW_INT_MIN, \
				  BT_GAP_ADV_SLOW_INT_MAX, NULL)


static uint8_t service_data[SERVICE_DATA_LEN] = {
    BT_UUID_16_ENCODE(SERVICE_UUID),
    0x40,
    0x02,	/* Temperature */
    0xc4,	/* Low byte */
    0x00,   /* High byte */
    0x04,	/* Pressure */
    0x13,	/* 50.55%  low byte*/
    0x8A,   /* 50.55%  high byte*/
    0x02,
};

static struct bt_data ad[] = {
    BT_DATA_BYTES(BT_DATA_FLAGS, BT_LE_AD_GENERAL | BT_LE_AD_NO_BREDR),
    BT_DATA(BT_DATA_NAME_COMPLETE, CONFIG_BT_DEVICE_NAME, sizeof(CONFIG_BT_DEVICE_NAME) - 1),
    BT_DATA(BT_DATA_SVC_DATA16, service_data, ARRAY_SIZE(service_data))
};

static void bt_ready(int err)
{
    if (err) {
        printk("Bluetooth init failed (err %d)\n", err);
        return;
    }

    printk("Bluetooth initialized\n");

    /* Start advertising */
    err = bt_le_adv_start(ADV_PARAM, ad, ARRAY_SIZE(ad), NULL, 0);
    if (err) {
        printk("Advertising failed to start (err %d)\n", err);
        return;
    }
}

int main(void)
{
    int err;
    int temp = 0;
    const struct device *dev = check_bme280_device();
    bmp280_data_t bmp280_data = {0};
    if (dev == NULL) {
        printk("Could not find BME280 device\n");
        return 0;
    }
    printk("Found BME280 device\n");
    printk("Starting BTHome sensor template\n");

    /* Initialize the Bluetooth Subsystem */
    err = bt_enable(bt_ready);
    if (err) {
        printk("Bluetooth init failed (err %d)\n", err);
        return 0;
    }

    for (;;) {
        read_sensor_data(&bmp280_data);
        /* Simulate temperature from 0C to 25C */
        service_data[IDX_TEMPH] = (bmp280_data.temperature) >> 8;
        service_data[IDX_TEMPL] = (bmp280_data.temperature) & 0xff;
        service_data[IDX_PRESSH] = (bmp280_data.pressure) >> 16;
        service_data[IDX_PRESSM] = ((bmp280_data.pressure) >> 8)& 0x0ff;
        service_data[IDX_PRESSL] = (bmp280_data.pressure) & 0xff;
        printk("Temperature H: %d, L: %d\n", service_data[IDX_TEMPH], service_data[IDX_TEMPL]);
        err = bt_le_adv_update_data(ad, ARRAY_SIZE(ad), NULL, 0);
        if (err) {
            printk("Failed to update advertising data (err %d)\n", err);
        }
        else {
            printk("Data updated with temp: %d\n", bmp280_data.temperature);
        }
        k_sleep(K_MSEC(BT_GAP_ADV_SLOW_INT_MIN));
    }
    return 0;
}
```

## src/bmp280.c
```c
#include "bmp280.h"
// 


/*
   * Get a device structure from a devicetree node with compatible
   * "bosch,bme280". (If there are multiple, just pick one.)
   */
const struct device *const dev = DEVICE_DT_GET_ANY(bosch_bme280);
SENSOR_DT_READ_IODEV(iodev, DT_COMPAT_GET_ANY_STATUS_OKAY(bosch_bme280),
                     [0]= {SENSOR_CHAN_AMBIENT_TEMP, 0},
                     [1]= {SENSOR_CHAN_HUMIDITY, 0},
                     [2]= {SENSOR_CHAN_PRESS, 0});

RTIO_DEFINE(ctx, 1, 1);

const struct device *check_bme280_device(void)
{
    if (dev == NULL) {
        /* No such node, or the node does not have status "okay". */
        printk("\nError: no device found.\n");
        return NULL;
    }

    if (!device_is_ready(dev)) {
        printk("\nError: Device \"%s\" is not ready; "
               "check the driver initialization logs for errors.\n",
               dev->name);
        return NULL;
    }

    printk("Found device \"%s\", getting sensor data\n", dev->name);
    return dev;
}

int read_sensor_data(bmp280_data_t *bmp280_data)
{
    uint8_t buf[128];

    int rc = sensor_read(&iodev, &ctx, buf, 128);

    if (rc != 0) {
        printk("%s: sensor_read() failed: %d\n", dev->name, rc);
        return rc;
    }

    const struct sensor_decoder_api *decoder;

    rc = sensor_get_decoder(dev, &decoder);

    if (rc != 0) {
        printk("%s: sensor_get_decode() failed: %d\n", dev->name, rc);
        return rc;
    }

    uint32_t temp_fit = 0;
    struct sensor_q31_data temp_data = {0};

    decoder->decode(buf,
    (struct sensor_chan_spec) {
        SENSOR_CHAN_AMBIENT_TEMP, 0
    },
    &temp_fit, 1, &temp_data);

    uint32_t press_fit = 0;
    struct sensor_q31_data press_data = {0};

    decoder->decode(buf,
    (struct sensor_chan_spec) {
        SENSOR_CHAN_PRESS, 0
    },
    &press_fit, 1, &press_data);

    printk("temp: %s%d.%d; press: %s%d.%d\n",
           PRIq_arg(temp_data.readings[0].temperature, 6, temp_data.shift),
           PRIq_arg(press_data.readings[0].pressure, 6, press_data.shift));
    char temp[10] = {0};
    sprintf(temp, "%s%d.%d", PRIq_arg(temp_data.readings[0].temperature, 2, temp_data.shift));
    bmp280_data->temperature = atof(temp)*100;
    char press[10] = {0};
    sprintf(press, "%s%d.%d", PRIq_arg(press_data.readings[0].pressure, 3, press_data.shift));
    bmp280_data->pressure = atof(press)*1000;
    //k_sleep(K_MSEC(1000));

	return 0;

}
```

## src/bmp280.h
```c
#ifndef _BMP280_H_
#define _BMP280_H_

#include <zephyr/devicetree.h>
#include <zephyr/drivers/sensor.h>
#include <zephyr/drivers/sensor_data_types.h>
#include <zephyr/rtio/rtio.h>
#include <zephyr/dsp/print_format.h>

typedef struct bmp280_data
{
    int temperature;
    int pressure;
}bmp280_data_t;

extern const struct device *const dev;
const struct device *check_bme280_device(void);
int read_sensor_data(bmp280_data_t *bmp280_data);

#endif
```
